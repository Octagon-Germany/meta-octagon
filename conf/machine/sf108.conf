## conf/machine/sf108.conf
```bitbake
#@TYPE: Machine
#@NAME: octagon sf108
#@DESCRIPTION: Machine configuration for the octagon sf108

MKUBIFS_ARGS = "-m 2048 -e 126976 -c 4096"
UBINIZE_ARGS = "-m 2048 -p 128KiB -s 2048"

MACHINE_FEATURES += "textlcd"

CHIPSET = "bcm7362"
RCTYPE = "18"

require conf/machine/include/octagon.inc

MACHINE_EXTRA_RDEPENDS += "enigma2-plugin-extensions-vfdcontrol"
```

## conf/machine/sf3038.conf
```bitbake
#@TYPE: Machine
#@NAME: octagon sf3038
#@DESCRIPTION: Machine configuration for the sf3038

MKUBIFS_ARGS = "-m 2048 -e 126976 -c 8192"
UBINIZE_ARGS = "-m 2048 -p 128KiB"

MACHINE_FEATURES += "textlcd dvb-c"

CHIPSET = "bcm7241"
RCTYPE = "18"

require conf/machine/include/octagon.inc
```
